## Documentation/devicetree/bindings/display/msm/mdp.txt
```
Qualcomm adreno/snapdragon display controller

Required properties:
- compatible:
  * "qcom,mdp4" - mdp4
  * "qcom,mdp5" - mdp5
- reg: Physical base address and length of the controller's registers.
- interrupts: The interrupt signal from the display controller.
- clocks: device clocks
  See ../clocks/clock-bindings.txt for details.
- clock-names: the following clocks are required.
  For MDP4:
   * "core_clk"
   * "iface_clk"
   * "lut_clk"
   * "src_clk"
   * "hdmi_clk"
   * "mdp_clk"
  For MDP5:
   * "bus_clk"
   * "iface_clk"
   * "core_clk_src"
   * "core_clk"
   * "lut_clk" (some MDP5 versions may not need this)
   * "vsync_clk"
- ports: contains the list of output ports from MDP. These connect to interfaces
  that are external to the MDP hardware, such as HDMI, DSI, EDP etc (LVDS is a
  special case since it is a part of the MDP block itself).

  Each output port contains an endpoint that describes how it is connected to an
  external interface. These are described by the standard properties documented
  here:
	Documentation/devicetree/bindings/graph.txt
	Documentation/devicetree/bindings/media/video-interfaces.txt

  For MDP4, the output port mappings are:
	Port 0 -> LCDC/LVDS
	Port 1 -> DSI1 Cmd/Video
	Port 2 -> DSI2 Cmd/Video
	Port 3 -> DTV

 For MDP5, the availability of output ports vary across each SoC revision, but
 they generally have the following mapping:
	Port 0 -> MDP_INTF0 (eDP)
	Port 1 -> MDP_INTF1 (DSI1)
	Port 2 -> MDP_INTF2 (DSI2)
	Port 3 -> MDP_INTF3 (HDMI)

 See drivers/gpu/drm/msm/mdp/mdp5/mdp5_cfg.c to see what all INTFs a particular
 SoC revision has enabled.

Optional properties:
- clock-names: the following clocks are optional:
  * "lut_clk"

Example:

/ {
	...

	hdmi: hdmi@4a00000 {
		...
		ports {
			...
			port@0 {
				reg = <0>;
				hdmi_in: endpoint {
					remote-endpoint = <&mdp_dtv_out>;
				};
			};
			...
		};
		...
	};

	mdp: mdp@5100000 {
		compatible = "qcom,mdp4";
		reg = <0x05100000 0xf0000>;
		interrupts = <GIC_SPI 75 0>;
		gpus = <&gpu>;
		clock-names =
		    "core_clk",
		    "iface_clk",
		    "lut_clk",
		    "src_clk",
		    "hdmi_clk",
		    "mdp_clk";
		clocks =
		    <&mmcc MDP_SRC>,
		    <&mmcc MDP_AHB_CLK>,
		    <&mmcc MDP_LUT_CLK>,
		    <&mmcc TV_SRC>,
		    <&mmcc HDMI_TV_CLK>,
		    <&mmcc MDP_TV_CLK>;

		ports {
			#address-cells = <1>;
			#size-cells = <0>;

				port@0 {
					reg = <0>;
					mdp_lvds_out: endpoint {
					};
				};

				port@1 {
					reg = <1>;
					mdp_dsi1_out: endpoint {
					};
				};

				port@2 {
					reg = <2>;
					mdp_dsi2_out: endpoint {
					};
				};

				port@3 {
					reg = <3>;
					mdp_dtv_out: endpoint {
						remote-endpoint = <&hdmi_in>;
					};
				};
		};
	};
};
```

## Documentation/devicetree/bindings/panel/jdi,lt070me05000.txt
```
JDI model LT070ME05000 1920x1200 7" DSI Panel

Basic data sheet is at:
	http://panelone.net/en/7-0-inch/JDI_LT070ME05000_7.0_inch-datasheet

This panel has command mode implemented currently in the driver.

Required properties:
- compatible: should be "jdi,lt070me05000"

Optional properties:
- power-supply: phandle of the regulator that provides the supply voltage
- reset-gpio: phandle of gpio for reset line
- backlight: phandle of the backlight device attached to the panel

Example:

	dsi@54300000 {
		panel: panel@0 {
			compatible = "jdi,lt070me05000";
			reg = <0>;

			power-supply = <...>;
			reset-gpio = <...>;
			backlight = <...>;
		};
	};
```

## Documentation/devicetree/bindings/thermal/qcom-tsens.txt
```
* QCOM SoC Temperature Sensor (TSENS)

Required properties:
- compatible :
 - "qcom,msm8916-tsens" : For 8916 Family of SoCs
 - "qcom,msm8974-tsens" : For 8974 Family of SoCs

- reg: Address range of the thermal registers
- #thermal-sensor-cells : Should be 1. See ./thermal.txt for a description.
- Refer to Documentation/devicetree/bindings/nvmem/nvmem.txt to know how to specify
nvmem cells

Example:
tsens: thermal-sensor@900000 {
		compatible = "qcom,msm8916-tsens";
		nvmem-cells = <&tsens_caldata>, <&tsens_calsel>;
		nvmem-cell-names = "caldata", "calsel";
		#thermal-sensor-cells = <1>;
	};
```
